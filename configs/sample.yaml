## configs/sample.yaml
```yaml
llm:
  type: openrouter
  model: "x-ai/grok-4-fast:free"
  base_url: https://openrouter.ai/api/v1
  api_key_env: OPENROUTER_API_KEY

workspace:
  root: .
  allow_outside_root: true

limits:
  max_iterations: 25
  command_timeout: 120
  max_failures: 5

tests:
  auto: false
  commands: []

policies:
  allow_network: true
  allow_shell_write: true

goals:
  apply_patch_success_rate:
    min: 0.9
  actions_success_rate:
    min: 0.85
  tests_success_rate:
    min: 0.95

loop:
  auto_seed: true
  seed_backlog: ../seed/backlog.yaml
  seed_config: seed_manual.yaml
  seed_interval: 0
  stop_when_idle: true
  use_memory: false
  memory_top_k: 3

audit:
  enable_file_log: true
  file_dir: seed/changes
  enable_git_commit: true
  low_risk_dry_run: false
  commit_prefix: "A3X"

autonomous_goals:
  enable: true
  config_file: "configs/seed_autonomous_goals.yaml"
  generation_interval: 300  # seconds between generations
  max_goals_per_cycle: 10

  # Trigger thresholds
  triggers:
    curiosity_threshold: 0.6
    performance_degradation_threshold: 0.8
    coverage_threshold: 0.7
    novelty_threshold: 0.5

  # Motivation profile
  motivation_profile:
    curiosity_weight: 0.3
    competence_weight: 0.25
    autonomy_weight: 0.2
    relatedness_weight: 0.15
    exploration_bias: 0.1

  # Seed backlog integration
  seed_backlog: "../seed/backlog.yaml"
  autonomous_goals_backlog: "../seed/autonomous_goals_backlog.yaml"
  enable_separate_backlog: true

  # Monitoring
  enable_metrics_collection: true
  metrics_file: "../seed/metrics/autonomous_goals_history.json"
  enable_goal_success_tracking: true
```
